## Krio-Yocto/BACKUP-META-KRIO/conf/layer.conf
```bitbake
# We have a conf and classes directory, add to BBPATH
BBPATH .= ":${LAYERDIR}"

# We have recipes-* directories, add to BBFILES
BBFILES += "${LAYERDIR}/recipes-*/*/*.bb \
            ${LAYERDIR}/recipes-*/*/*.bbappend"

BBFILE_COLLECTIONS += "krio"
BBFILE_PATTERN_krio = "^${LAYERDIR}/"
BBFILE_PRIORITY_krio = "6"

LAYERDEPENDS_krio = "core xilinx kria"
LAYERSERIES_COMPAT_krio = "scarthgap"
```

## Krio-Yocto/meta-krio/conf/layer.conf
```bitbake
# We have a conf and classes directory, add to BBPATH
BBPATH .= ":${LAYERDIR}"

# We have a packages directory, add to BBFILES
BBFILES += " \
    ${LAYERDIR}/recipes-*/*/*.bb \
    ${LAYERDIR}/recipes-*/*/*.bbappend \
    "

BBFILE_COLLECTIONS += "krio"
BBFILE_PRIORITY_krio = "6"
BBFILE_PATTERN_krio = "^${LAYERDIR}/"

LAYERDEPENDS_krio  = "core xilinx"

LAYERRECOMMENDS_krio = "xilinx-tools"

LAYERSERIES_COMPAT_krio = "scarthgap"
```
